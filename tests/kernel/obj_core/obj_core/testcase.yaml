## tests/kernel/obj_core/obj_core/testcase.yaml
```yaml
tests:
  kernel.obj_core:
    tags:
      - kernel
      - userspace
    ignore_faults: true
```

## tests/kernel/obj_core/obj_core_stats/testcase.yaml
```yaml
tests:
  kernel.obj_core_stats:
    tags:
      - kernel
      - userspace
    ignore_faults: true
```
